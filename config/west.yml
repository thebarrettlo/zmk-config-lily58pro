## config/west.yml
```yaml
manifest:
  remotes:
    - name: infused-kim   # zmkfirmware
      url-base: https://github.com/infused-kim  # https://github.com/zmkfirmware
  projects:
    - name: zmk
      remote: infused-kim   # zmkfirmware
      revision: my-changes/oled-ext-pwr   # main
      import: app/west.yml
  self:
    path: config
```
